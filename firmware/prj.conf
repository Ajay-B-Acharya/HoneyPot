## CMakeLists.txt
```
#
# IoT Honeypot Monitor — FRDM-RW612 Firmware Build Configuration
#

cmake_minimum_required(VERSION 3.22.0)

include(${SdkRootDirPath}/cmake/extension/mcux.cmake)

project(iot_honeypot LANGUAGES C CXX ASM PROJECT_BOARD_PORT_PATH ${board_root}/${board}/wifi_examples/wifi_httpsrv)

include(${SdkRootDirPath}/CMakeLists.txt)

mcux_add_source(
    SOURCES
        src/main.c
        src/detection_rules.c
        src/honeypot_server.c
        src/telemetry_client.c
        FreeRTOSConfig.h
        lwipopts.h
        lwippools.h
        wifi_config.h
)

mcux_add_source(
    BASE_PATH ${SdkRootDirPath}
    SOURCES
        ${board_root}/${board}/FreeRTOSConfigBoard.h
        ${board_root}/${board}/wifi_examples/common/pin_mux.c
        ${board_root}/${board}/wifi_examples/common/pin_mux.h
)

mcux_add_include(
    INCLUDES
        include
        src
        .
)

mcux_add_include(
    BASE_PATH ${SdkRootDirPath}
    INCLUDES
        ${board_root}/${board}/wifi_examples/common
)

# Macro configuration
mcux_add_macro(
    CC "-DUSE_RTOS=1\
       -DPRINTF_ADVANCED_ENABLE=1"
)

mcux_add_armgcc_linker_script(
    BASE_PATH ${SdkRootDirPath}
    TARGETS debug release flexspi_nor_debug flexspi_nor_release flash_debug flash_release
    LINKER ${board_root}/${board}/wifi_examples/common/linker/${CONFIG_MCUX_TOOLCHAIN_LINKER_DEVICE_PREFIX}_wifi.ld
)

include(${SdkRootDirPath}/${board_root}/${board}/wifi_examples/wifi_httpsrv/reconfig.cmake OPTIONAL)

mcux_convert_binary(BINARY ${APPLICATION_BINARY_DIR}/${MCUX_SDK_PROJECT_NAME}.bin)
```

## prj.conf
```kconfig
CONFIG_MCUX_COMPONENT_component.wifi_bt_module.config=y
CONFIG_MCUX_COMPONENT_middleware.edgefast_wifi_nxp=y
CONFIG_MCUX_COMPONENT_middleware.freertos-kernel=y
CONFIG_MCUX_COMPONENT_middleware.freertos-kernel.heap_4=y
CONFIG_MCUX_COMPONENT_middleware.freertos-kernel.extension=y
CONFIG_MCUX_COMPONENT_middleware.lwip=y
CONFIG_MCUX_COMPONENT_middleware.wifi=y
CONFIG_MCUX_PRJSEG_middleware.freertos-kernel.generated_config=n
CONFIG_MCUX_PRJSEG_module.board.console_lite=n
CONFIG_MCUX_PRJSEG_module.board.console=y
CONFIG_MCUX_PRJSEG_module.board.pinmux_customize_folder=y
CONFIG_MCUX_PRJSEG_project.hw_app_customize_folder=y
CONFIG_MCUX_COMPONENT_driver.conn_fwloader.fw_bin=y
CONFIG_MCUX_COMPONENT_component.wifi_bt_module.wifi_fw=y
```

## src/main.c
```c
/*
 * IoT Honeypot Monitor — FRDM-RW612 Embedded Honeypot Firmware Entry Point
 *
 * Implements:
 * - NXP WPL Wi-Fi connectivity
 * - FreeRTOS multitasking
 * - Honeypot decoy HTTP server (port 80)
 * - Edge threat detection (Rule R1 unknown endpoint, R2 rate, R3 repeated probes)
 * - Telemetry reporting to central FastAPI backend
 */

#include "FreeRTOS.h"
#include "task.h"
#include "timers.h"

#include "lwip/tcpip.h"
#include "lwip/netif.h"

#include "board.h"
#include "app.h"
#include "wpl.h"
#include "fsl_debug_console.h"

#include "honeypot_config.h"
#include "detection_rules.h"
#include "honeypot_server.h"
#include "telemetry_client.h"

#include <stdio.h>
#include <string.h>

/* Link state callback */
static void LinkStatusChangeCallback(bool linkState)
{
    if (!linkState) {
        PRINTF("[Wi-Fi] Link Lost! Will attempt automatic reconnect.\r\n");
    } else {
        PRINTF("[Wi-Fi] Link Re-established successfully.\r\n");
    }
}

/* Connect to Access Point */
static bool WiFi_ConnectAP(void)
{
    int32_t result;

    PRINTF("[Wi-Fi] Initializing NXP WPL stack...\r\n");
    result = WPL_Init();
    PRINTF("[Wi-Fi] WPL_Init returned %ld\r\n", (long)result);
    if (result != WPLRET_SUCCESS) {
        PRINTF("[Wi-Fi] WPL_Init failed with code %ld!\r\n", (long)result);
        return false;
    }

    PRINTF("[Wi-Fi] Starting WPL module...\r\n");
    result = WPL_Start(LinkStatusChangeCallback);
    PRINTF("[Wi-Fi] WPL_Start returned %ld\r\n", (long)result);
    if (result != WPLRET_SUCCESS) {
        PRINTF("[Wi-Fi] WPL_Start failed with code %ld!\r\n", (long)result);
        return false;
    }
    PRINTF("[Wi-Fi] WPL module started successfully.\r\n");

    PRINTF("[Wi-Fi] Adding AP network credentials: %s\r\n", HONEYPOT_WIFI_SSID);
    result = WPL_AddNetwork(HONEYPOT_WIFI_SSID, HONEYPOT_WIFI_PASS, HONEYPOT_WIFI_LABEL);
    PRINTF("[Wi-Fi] WPL_AddNetwork returned %ld\r\n", (long)result);
    if (result != WPLRET_SUCCESS) {
        PRINTF("[Wi-Fi] WPL_AddNetwork failed with code %ld!\r\n", (long)result);
        return false;
    }

    PRINTF("[Wi-Fi] Joining network '%s'...\r\n", HONEYPOT_WIFI_SSID);
    result = WPL_Join(HONEYPOT_WIFI_LABEL);
    PRINTF("[Wi-Fi] WPL_Join returned %ld\r\n", (long)result);
    if (result != WPLRET_SUCCESS) {
        PRINTF("[Wi-Fi] Association failed (code %ld). Running in standalone honeypot mode.\r\n", (long)result);
        return false;
    }

    char ip_str[16];
    WPL_GetIP(ip_str, 1);
    PRINTF("[Wi-Fi] Associated successfully! Local IP: %s\r\n", ip_str);
    return true;
}

/* Main supervisor task */
static void Main_Supervisor_Task(void *arg)
{
    (void)arg;

    PRINTF("\r\n=======================================================\r\n");
    PRINTF("  IoT Honeypot Monitor — NXP FRDM-RW612 Firmware\r\n");
    PRINTF("  Device ID   : %s\r\n", HONEYPOT_DEVICE_ID);
    PRINTF("  Firmware    : %s\r\n", HONEYPOT_FW_VERSION);
    PRINTF("  Backend Host: %s:%d\r\n", BACKEND_HOST_IP, BACKEND_HOST_PORT);
    PRINTF("=======================================================\r\n\r\n");

    /* 1. Initialize Edge Detection System */
    Detection_Init();

    /* 2. Initialize Telemetry Dispatcher */
    if (!Telemetry_Init()) {
        PRINTF("[Main] Telemetry initialization failed!\r\n");
    }

    /* 3. Connect to Wi-Fi */
    WiFi_ConnectAP();

    /* 4. Start Telemetry Dispatcher Task */
    BaseType_t status = xTaskCreate(Telemetry_Task,
                                    "telemetry_tx",
                                    2048,
                                    NULL,
                                    configMAX_PRIORITIES - 5,
                                    NULL);
    if (status != pdPASS) {
        PRINTF("[Main] Failed to create Telemetry Dispatcher Task!\r\n");
    }

    /* 5. Start Honeypot HTTP Server Task */
    status = xTaskCreate(Honeypot_Server_Task,
                         "honeypot_srv",
                         2048,
                         NULL,
                         configMAX_PRIORITIES - 4,
                         NULL);
    if (status != pdPASS) {
        PRINTF("[Main] Failed to create Honeypot Server Task!\r\n");
    }

    PRINTF("[Main] All honeypot services active. Awaiting network interactions.\r\n");
    vTaskDelete(NULL);
}

int main(void)
{
    /* Initialize NXP Board Peripherals, Clocks, and UART Debug Console */
    BOARD_InitHardware();

    /* Create Main Supervisor Task */
    if (xTaskCreate(Main_Supervisor_Task,
                    "main_sup",
                    2048,
                    NULL,
                    configMAX_PRIORITIES - 4,
                    NULL) != pdPASS) {
        PRINTF("[Main] Main task creation failed!\r\n");
        for (;;) {
            __BKPT(0);
        }
    }

    /* Start FreeRTOS Kernel Scheduler */
    vTaskStartScheduler();

    /* Execution should never reach here */
    for (;;) {
        ;
    }
}
```

## src/detection_rules.c
```c
/*
 * IoT Honeypot Monitor — FRDM-RW612 Edge Intrusion Detection Rules Implementation
 */

#include "detection_rules.h"
#include "honeypot_config.h"

#include <string.h>
#include <stdio.h>
#include <ctype.h>

#define RATE_RING_SIZE 32

/* In-memory sliding buffer for edge rate monitoring */
static uint32_t s_request_ticks[RATE_RING_SIZE];
static uint32_t s_ring_head = 0;
static uint32_t s_total_recorded = 0;

/* Repeated request tracking */
static char s_last_endpoint[128] = "";
static char s_last_ip[48] = "";
static uint32_t s_repeat_count = 0;

void Detection_Init(void)
{
    memset(s_request_ticks, 0, sizeof(s_request_ticks));
    s_ring_head = 0;
    s_total_recorded = 0;
    memset(s_last_endpoint, 0, sizeof(s_last_endpoint));
    memset(s_last_ip, 0, sizeof(s_last_ip));
    s_repeat_count = 0;
}

void Detection_NormalizePath(const char *raw_path, char *out_path, size_t max_len)
{
    if (!raw_path || !out_path || max_len < 2) {
        if (out_path && max_len > 1) {
            out_path[0] = '/';
            out_path[1] = '\0';
        }
        return;
    }

    size_t in_len = strlen(raw_path);
    size_t out_idx = 0;

    /* Ensure leading slash */
    out_path[out_idx++] = '/';

    size_t i = 0;
    /* Skip leading whitespace and leading slashes */
    while (i < in_len && (raw_path[i] == ' ' || raw_path[i] == '/')) {
        i++;
    }

    bool last_was_slash = true;

    while (i < in_len && out_idx < (max_len - 1)) {
        char c = raw_path[i];

        /* Stop at query string or fragment */
        if (c == '?' || c == '#') {
            break;
        }

        /* Collapse multiple consecutive slashes */
        if (c == '/') {
            if (!last_was_slash) {
                out_path[out_idx++] = '/';
                last_was_slash = true;
            }
        } else {
            out_path[out_idx++] = c;
            last_was_slash = false;
        }
        i++;
    }

    /* Strip trailing slash unless root '/' */
    if (out_idx > 1 && out_path[out_idx - 1] == '/') {
        out_idx--;
    }

    out_path[out_idx] = '\0';
}

bool Detection_IsAllowedEndpoint(const char *normalized_path)
{
    if (!normalized_path) return false;

    if (strcmp(normalized_path, "/status") == 0 ||
        strcmp(normalized_path, "/info") == 0 ||
        strcmp(normalized_path, "/config") == 0) {
        return true;
    }
    return false;
}

void Detection_Evaluate(RequestRecord_t *record)
{
    if (!record) return;

    record->triggered_event = EVENT_NONE;
    record->severity = SEV_INFORMATIONAL;
    record->event_description[0] = '\0';

    /* Rule R1: Unknown Endpoint Detection */
    if (!Detection_IsAllowedEndpoint(record->endpoint)) {
        record->is_unknown_endpoint = true;
        record->triggered_event = EVENT_UNKNOWN_ENDPOINT;
        record->severity = SEV_WARNING;
        snprintf(record->event_description, sizeof(record->event_description),
                 "Request received for unknown endpoint: '%s'", record->endpoint);
        return;
    } else {
        record->is_unknown_endpoint = false;
    }

    /* Rule R2: Request-Rate Tracking (Sliding Tick Window) */
    uint32_t now_tick = record->timestamp_tick;
    s_request_ticks[s_ring_head] = now_tick;
    s_ring_head = (s_ring_head + 1) % RATE_RING_SIZE;
    if (s_total_recorded < RATE_RING_SIZE) {
        s_total_recorded++;
    }

    uint32_t window_count = 0;
    for (uint32_t k = 0; k < s_total_recorded; k++) {
        if ((now_tick >= s_request_ticks[k]) &&
            ((now_tick - s_request_ticks[k]) <= EDGE_RATE_WINDOW_MS)) {
            window_count++;
        }
    }

    if (window_count >= EDGE_RATE_THRESHOLD) {
        record->triggered_event = EVENT_HIGH_REQUEST_RATE;
        record->severity = SEV_WARNING;
        snprintf(record->event_description, sizeof(record->event_description),
                 "High request rate detected from %s: %lu requests in window",
                 record->source_ip, (unsigned long)window_count);
        return;
    }

    /* Rule R3: Repeated Endpoint Probing */
    if (strcmp(s_last_endpoint, record->endpoint) == 0 &&
        strcmp(s_last_ip, record->source_ip) == 0) {
        s_repeat_count++;
        if (s_repeat_count >= EDGE_REPEATED_THRESHOLD) {
            record->triggered_event = EVENT_REPEATED_REQUESTS;
            record->severity = SEV_WARNING;
            snprintf(record->event_description, sizeof(record->event_description),
                     "Repeated requests detected for endpoint '%s': %lu requests",
                     record->endpoint, (unsigned long)s_repeat_count);
            return;
        }
    } else {
        strncpy(s_last_endpoint, record->endpoint, sizeof(s_last_endpoint) - 1);
        strncpy(s_last_ip, record->source_ip, sizeof(s_last_ip) - 1);
        s_repeat_count = 1;
    }
}

const char *Detection_GetSeverityString(EventSeverity_t severity)
{
    switch (severity) {
        case SEV_CRITICAL: return "critical";
        case SEV_WARNING:  return "warning";
        default:           return "informational";
    }
}

const char *Detection_GetEventString(SecurityEventType_t event_type)
{
    switch (event_type) {
        case EVENT_UNKNOWN_ENDPOINT:    return "unknown_endpoint";
        case EVENT_HIGH_REQUEST_RATE:   return "high_request_rate";
        case EVENT_REPEATED_REQUESTS:   return "repeated_requests";
        case EVENT_MALFORMED_METADATA:  return "malformed_request";
        default:                        return "normal_traffic";
    }
}
```

## src/detection_rules.h
```c
/*
 * IoT Honeypot Monitor — FRDM-RW612 Edge Intrusion Detection Rules Header
 */

#ifndef DETECTION_RULES_H_
#define DETECTION_RULES_H_

#include <stdbool.h>
#include <stdint.h>
#include <stddef.h>

typedef enum {
    SEV_INFORMATIONAL = 0,
    SEV_WARNING = 1,
    SEV_CRITICAL = 2
} EventSeverity_t;

typedef enum {
    EVENT_NONE = 0,
    EVENT_UNKNOWN_ENDPOINT,
    EVENT_HIGH_REQUEST_RATE,
    EVENT_REPEATED_REQUESTS,
    EVENT_MALFORMED_METADATA
} SecurityEventType_t;

typedef struct {
    char method[12];
    char endpoint[128];
    char source_ip[48];
    int response_code;
    uint32_t timestamp_tick;
    bool is_unknown_endpoint;
    SecurityEventType_t triggered_event;
    EventSeverity_t severity;
    char event_description[128];
} RequestRecord_t;

/* Initialize edge detection tracking state */
void Detection_Init(void);

/* Normalize HTTP path safely: strips query strings, collapses duplicate slashes */
void Detection_NormalizePath(const char *raw_path, char *out_path, size_t max_len);

/* Check if normalized endpoint is in allowlist (/status, /info, /config) */
bool Detection_IsAllowedEndpoint(const char *normalized_path);

/* Evaluate request against edge detection rules */
void Detection_Evaluate(RequestRecord_t *record);

/* Helper to convert enum to string representations */
const char *Detection_GetSeverityString(EventSeverity_t severity);
const char *Detection_GetEventString(SecurityEventType_t event_type);

#endif /* DETECTION_RULES_H_ */
```

## src/honeypot_server.c
```c
/*
 * IoT Honeypot Monitor — FRDM-RW612 Honeypot HTTP Server Implementation
 */

#include "honeypot_server.h"
#include "honeypot_config.h"
#include "detection_rules.h"
#include "telemetry_client.h"

#include "FreeRTOS.h"
#include "task.h"

#include "lwip/sockets.h"
#include "fsl_debug_console.h"

#include <stdio.h>
#include <string.h>

static void HandleHttpClient(int client_sock, struct sockaddr_in *client_addr)
{
    char rx_buffer[1024];
    char resp_body[256];
    char http_resp[512];

    struct timeval tv;
    tv.tv_sec = 3;
    tv.tv_usec = 0;
    setsockopt(client_sock, SOL_SOCKET, SO_RCVTIMEO, &tv, sizeof(tv));

    int bytes_read = recv(client_sock, rx_buffer, sizeof(rx_buffer) - 1, 0);
    if (bytes_read <= 0) {
        close(client_sock);
        return;
    }
    rx_buffer[bytes_read] = '\0';

    /* Parse request line: e.g. "GET /status HTTP/1.1" */
    char method[12] = "GET";
    char raw_path[128] = "/";
    char norm_path[128] = "/";

    char *first_space = strchr(rx_buffer, ' ');
    if (first_space != NULL) {
        size_t method_len = first_space - rx_buffer;
        if (method_len < sizeof(method)) {
            memcpy(method, rx_buffer, method_len);
            method[method_len] = '\0';
        }

        char *second_space = strchr(first_space + 1, ' ');
        if (second_space != NULL) {
            size_t path_len = second_space - (first_space + 1);
            if (path_len < sizeof(raw_path)) {
                memcpy(raw_path, first_space + 1, path_len);
                raw_path[path_len] = '\0';
            }
        }
    }

    Detection_NormalizePath(raw_path, norm_path, sizeof(norm_path));

    /* Populate Request Record */
    RequestRecord_t record;
    memset(&record, 0, sizeof(record));
    strncpy(record.method, method, sizeof(record.method) - 1);
    strncpy(record.endpoint, norm_path, sizeof(record.endpoint) - 1);
    strncpy(record.source_ip, inet_ntoa(client_addr->sin_addr), sizeof(record.source_ip) - 1);
    record.timestamp_tick = xTaskGetTickCount() * portTICK_PERIOD_MS;

    /* Evaluate Threat Rules on Board */
    Detection_Evaluate(&record);

    int status_code = 200;
    const char *status_text = "OK";

    if (strcmp(norm_path, "/status") == 0) {
        uint32_t uptime_sec = (record.timestamp_tick / 1000);
        snprintf(resp_body, sizeof(resp_body),
                 "{\"device_status\":\"ok\",\"uptime_sec\":%lu,\"device_id\":\"%s\",\"free_heap\":%u}\r\n",
                 (unsigned long)uptime_sec, HONEYPOT_DEVICE_ID, (unsigned int)xPortGetFreeHeapSize());
    } else if (strcmp(norm_path, "/info") == 0) {
        snprintf(resp_body, sizeof(resp_body),
                 "{\"vendor\":\"NXP Semiconductors\",\"model\":\"%s\",\"firmware\":\"%s\",\"device_id\":\"%s\"}\r\n",
                 HONEYPOT_MODEL, HONEYPOT_FW_VERSION, HONEYPOT_DEVICE_ID);
    } else if (strcmp(norm_path, "/config") == 0) {
        snprintf(resp_body, sizeof(resp_body),
                 "{\"dhcp_enabled\":true,\"reporting_interval_ms\":5000,\"telemetry_mode\":\"edge\"}\r\n");
    } else {
        /* Unknown Endpoint -> 404 Decoy */
        status_code = 404;
        status_text = "Not Found";
        snprintf(resp_body, sizeof(resp_body),
                 "{\"error\":\"Not Found\",\"endpoint\":\"%s\"}\r\n", norm_path);
    }

    record.response_code = status_code;

    /* Format HTTP response headers and body */
    int resp_len = snprintf(http_resp, sizeof(http_resp),
                            "HTTP/1.1 %d %s\r\n"
                            "Content-Type: application/json\r\n"
                            "Content-Length: %d\r\n"
                            "Server: NXP-FRDM-RW612-Honeypot\r\n"
                            "Connection: close\r\n\r\n"
                            "%s",
                            status_code, status_text, (int)strlen(resp_body), resp_body);

    if (resp_len > 0) {
        send(client_sock, http_resp, resp_len, 0);
    }
    close(client_sock);

    PRINTF("[Honeypot] %s %s from %s -> %d %s %s\r\n",
           record.method, record.endpoint, record.source_ip,
           record.response_code,
           record.is_unknown_endpoint ? "[ALERT: Unknown Endpoint]" : "",
           record.triggered_event == EVENT_HIGH_REQUEST_RATE ? "[ALERT: High Rate]" : "");

    /* Forward to Telemetry Queue for Ingestion */
    Telemetry_Enqueue(&record);
}

void Honeypot_Server_Task(void *param)
{
    (void)param;
    int listen_sock = -1;
    struct sockaddr_in server_addr;

    PRINTF("[Honeypot] Starting Honeypot HTTP Listener on port %d...\r\n", HONEYPOT_HTTP_PORT);

    while (listen_sock < 0) {
        listen_sock = socket(AF_INET, SOCK_STREAM, 0);
        if (listen_sock < 0) {
            PRINTF("[Honeypot] Waiting for network stack... (socket error: %d)\r\n", listen_sock);
            vTaskDelay(pdMS_TO_TICKS(1500));
        }
    }

    int enable = 1;
    setsockopt(listen_sock, SOL_SOCKET, SO_REUSEADDR, &enable, sizeof(enable));

    memset(&server_addr, 0, sizeof(server_addr));
    server_addr.sin_family = AF_INET;
    server_addr.sin_addr.s_addr = htonl(INADDR_ANY);
    server_addr.sin_port = htons(HONEYPOT_HTTP_PORT);

    while (bind(listen_sock, (struct sockaddr *)&server_addr, sizeof(server_addr)) < 0) {
        PRINTF("[Honeypot] Socket bind() retrying in 1s...\r\n");
        vTaskDelay(pdMS_TO_TICKS(1000));
    }

    if (listen(listen_sock, 4) < 0) {
        PRINTF("[Honeypot] Socket listen() failed!\r\n");
        close(listen_sock);
        vTaskDelete(NULL);
        return;
    }

    PRINTF("[Honeypot] Decoy server active. Decoy routes: /status, /info, /config\r\n");

    for (;;) {
        struct sockaddr_in client_addr;
        socklen_t client_len = sizeof(client_addr);
        int client_sock = accept(listen_sock, (struct sockaddr *)&client_addr, &client_len);

        if (client_sock >= 0) {
            HandleHttpClient(client_sock, &client_addr);
        }
    }
}
```

## src/honeypot_server.h
```c
/*
 * IoT Honeypot Monitor — FRDM-RW612 Honeypot HTTP Server Header
 */

#ifndef HONEYPOT_SERVER_H_
#define HONEYPOT_SERVER_H_

/* FreeRTOS honeypot server task entry point */
void Honeypot_Server_Task(void *param);

#endif /* HONEYPOT_SERVER_H_ */
```

## src/telemetry_client.c
```c
/*
 * IoT Honeypot Monitor — FRDM-RW612 Telemetry Dispatcher Implementation
 */

#include "telemetry_client.h"
#include "honeypot_config.h"

#include "FreeRTOS.h"
#include "task.h"
#include "queue.h"

#include "lwip/sockets.h"
#include "lwip/netdb.h"
#include "fsl_debug_console.h"

#include <stdio.h>
#include <string.h>

static QueueHandle_t s_telemetry_queue = NULL;

bool Telemetry_Init(void)
{
    if (s_telemetry_queue != NULL) {
        return true;
    }

    s_telemetry_queue = xQueueCreate(TELEMETRY_QUEUE_LENGTH, sizeof(RequestRecord_t));
    if (s_telemetry_queue == NULL) {
        PRINTF("[Telemetry] Failed to create FreeRTOS telemetry queue!\r\n");
        return false;
    }

    return true;
}

bool Telemetry_Enqueue(const RequestRecord_t *record)
{
    if (s_telemetry_queue == NULL || record == NULL) {
        return false;
    }

    BaseType_t status = xQueueSend(s_telemetry_queue, record, pdMS_TO_TICKS(50));
    if (status != pdPASS) {
        PRINTF("[Telemetry] Queue full! Dropping oldest telemetry record.\r\n");
        RequestRecord_t dummy;
        xQueueReceive(s_telemetry_queue, &dummy, 0);
        xQueueSend(s_telemetry_queue, record, 0);
    }
    return true;
}

static bool SendHttpPayload(const char *path, const char *json_payload)
{
    int sock = socket(AF_INET, SOCK_STREAM, 0);
    if (sock < 0) {
        PRINTF("[Telemetry] socket() failed: %d\r\n", sock);
        return false;
    }

    struct timeval tv;
    tv.tv_sec = TELEMETRY_TIMEOUT_MS / 1000;
    tv.tv_usec = (TELEMETRY_TIMEOUT_MS % 1000) * 1000;
    setsockopt(sock, SOL_SOCKET, SO_RCVTIMEO, &tv, sizeof(tv));
    setsockopt(sock, SOL_SOCKET, SO_SNDTIMEO, &tv, sizeof(tv));

    struct sockaddr_in serv_addr;
    memset(&serv_addr, 0, sizeof(serv_addr));
    serv_addr.sin_family = AF_INET;
    serv_addr.sin_port = htons(BACKEND_HOST_PORT);
    serv_addr.sin_addr.s_addr = inet_addr(BACKEND_HOST_IP);

    if (connect(sock, (struct sockaddr *)&serv_addr, sizeof(serv_addr)) < 0) {
        PRINTF("[Telemetry] connect() to %s:%d failed!\r\n", BACKEND_HOST_IP, BACKEND_HOST_PORT);
        close(sock);
        return false;
    }

    char http_req[1024];
    int req_len = snprintf(http_req, sizeof(http_req),
                           "POST %s HTTP/1.1\r\n"
                           "Host: %s:%d\r\n"
                           "Content-Type: application/json\r\n"
                           "Content-Length: %d\r\n"
                           "Connection: close\r\n\r\n"
                           "%s",
                           path, BACKEND_HOST_IP, BACKEND_HOST_PORT,
                           (int)strlen(json_payload), json_payload);

    if (req_len <= 0 || req_len >= (int)sizeof(http_req)) {
        close(sock);
        return false;
    }

    int sent = send(sock, http_req, req_len, 0);
    if (sent < 0) {
        PRINTF("[Telemetry] send() failed!\r\n");
        close(sock);
        return false;
    }

    char rx_buf[256];
    int recvd = recv(sock, rx_buf, sizeof(rx_buf) - 1, 0);
    close(sock);

    if (recvd > 0) {
        rx_buf[recvd] = '\0';
        if (strstr(rx_buf, "200 OK") != NULL || strstr(rx_buf, "201 Created") != NULL) {
            return true;
        }
        PRINTF("[Telemetry] Backend responded with non-2xx status: %.32s\r\n", rx_buf);
    }
    return false;
}

void Telemetry_Task(void *param)
{
    (void)param;
    RequestRecord_t record;
    char json_buf[512];

    PRINTF("[Telemetry] Telemetry task running. Target: %s:%d\r\n",
           BACKEND_HOST_IP, BACKEND_HOST_PORT);

    for (;;) {
        if (xQueueReceive(s_telemetry_queue, &record, portMAX_DELAY) == pdPASS) {
            /* 1. Format and dispatch POST /api/logs payload */
            snprintf(json_buf, sizeof(json_buf),
                     "{"
                     "\"timestamp\":\"2026-10-27T08:00:00Z\","
                     "\"device_id\":\"%s\","
                     "\"source_ip\":\"%s\","
                     "\"method\":\"%s\","
                     "\"endpoint\":\"%s\","
                     "\"response_code\":%d,"
                     "\"classification\":\"%s\""
                     "}",
                     HONEYPOT_DEVICE_ID,
                     record.source_ip,
                     record.method,
                     record.endpoint,
                     record.response_code,
                     record.is_unknown_endpoint ? "unusual" : "normal");

            bool sent_ok = false;
            for (int attempt = 1; attempt <= TELEMETRY_MAX_RETRIES; attempt++) {
                if (SendHttpPayload("/api/logs", json_buf)) {
                    PRINTF("[Telemetry] Ingested log: %s %s -> HTTP %d\r\n",
                           record.method, record.endpoint, record.response_code);
                    sent_ok = true;
                    break;
                }
                PRINTF("[Telemetry] Log dispatch retry %d/%d...\r\n", attempt, TELEMETRY_MAX_RETRIES);
                vTaskDelay(pdMS_TO_TICKS(1000 * attempt));
            }
            if (!sent_ok) {
                PRINTF("[Telemetry] Warning: Log dispatch failed after all retries.\r\n");
            }

            /* 2. If a security anomaly occurred, dispatch POST /api/events */
            if (record.triggered_event != EVENT_NONE) {
                snprintf(json_buf, sizeof(json_buf),
                         "{"
                         "\"timestamp\":\"2026-10-27T08:00:00Z\","
                         "\"device_id\":\"%s\","
                         "\"event_type\":\"%s\","
                         "\"severity\":\"%s\","
                         "\"description\":\"%s\","
                         "\"source_ip\":\"%s\","
                         "\"metadata\":{\"endpoint\":\"%s\",\"method\":\"%s\"}"
                         "}",
                         HONEYPOT_DEVICE_ID,
                         Detection_GetEventString(record.triggered_event),
                         Detection_GetSeverityString(record.severity),
                         record.event_description,
                         record.source_ip,
                         record.endpoint,
                         record.method);

                for (int attempt = 1; attempt <= TELEMETRY_MAX_RETRIES; attempt++) {
                    if (SendHttpPayload("/api/events", json_buf)) {
                        PRINTF("[Telemetry] Alert dispatched! Type: %s, Sev: %s\r\n",
                               Detection_GetEventString(record.triggered_event),
                               Detection_GetSeverityString(record.severity));
                        break;
                    }
                    vTaskDelay(pdMS_TO_TICKS(1000 * attempt));
                }
            }
        }
    }
}
```

## src/telemetry_client.h
```c
/*
 * IoT Honeypot Monitor — FRDM-RW612 Telemetry Dispatcher Header
 */

#ifndef TELEMETRY_CLIENT_H_
#define TELEMETRY_CLIENT_H_

#include "detection_rules.h"
#include <stdbool.h>

/* Initialize telemetry client queue and FreeRTOS task */
bool Telemetry_Init(void);

/* Enqueue an observed request for backend reporting */
bool Telemetry_Enqueue(const RequestRecord_t *record);

/* Task entry point for FreeRTOS */
void Telemetry_Task(void *param);

#endif /* TELEMETRY_CLIENT_H_ */
```
